## main/Kconfig.projbuild
```kconfig
menu "YouTube Sticky"

    config YOUTUBE_WIFI_SSID
      string "Wi-Fi SSID"
      default ""
      help
          Wi-Fi network used by the Sticky to reach YouTube directly.

    config YOUTUBE_WIFI_PASSWORD
      string "Wi-Fi password"
      default ""

    config YOUTUBE_API_KEY
      string "YouTube Data API key"
      default ""
      help
          Optional developer-build default. Do not commit a personal API key; generic builds should use the first-boot setup page.

    config YOUTUBE_CHANNEL
      string "YouTube channel ID or @handle"
      default "@PBJSquad"

    endmenu
```

## sdkconfig.defaults
```kconfig
CONFIG_IDF_TARGET="esp32s3"
    CONFIG_ESPTOOLPY_FLASHSIZE_16MB=y
    CONFIG_PARTITION_TABLE_SINGLE_APP_LARGE=y
    CONFIG_ESP_MAIN_TASK_STACK_SIZE=8192
    CONFIG_ESP_DEFAULT_CPU_FREQ_MHZ_240=y
    CONFIG_SPIRAM=y
    CONFIG_SPIRAM_MODE_QUAD=y
    CONFIG_ESP_WIFI_ENABLED=y
    CONFIG_MBEDTLS_CERTIFICATE_BUNDLE=y
    CONFIG_MBEDTLS_CERTIFICATE_BUNDLE_DEFAULT_FULL=y
    
```
